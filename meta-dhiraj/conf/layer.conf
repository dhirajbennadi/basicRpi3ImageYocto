## meta-dhiraj/conf/layer.conf
```bitbake
# We have a conf and classes directory, add to BBPATH
BBPATH .= ":${LAYERDIR}"

# We have recipes-* directories, add to BBFILES
BBFILES += "${LAYERDIR}/recipes-*/*/*.bb \
            ${LAYERDIR}/recipes-*/*/*.bbappend"

BBFILE_COLLECTIONS += "meta-dhiraj"
BBFILE_PATTERN_meta-dhiraj = "^${LAYERDIR}/"
BBFILE_PRIORITY_meta-dhiraj = "6"

LAYERDEPENDS_meta-dhiraj = "core"
LAYERSERIES_COMPAT_meta-dhiraj = "dunfell"
```
